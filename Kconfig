## Kconfig
```kconfig
#
# Copyright 2014, Wink Saville
#
# This software may be distributed and modified according to the terms of
# the BSD 2-Clause license. Note that NO WARRANTY is provided.
# See "LICENSE_BSD2.txt" for details.

# This file defines the Kconfig menu structure.

mainmenu "Project Configuration"

config COMMON_PATH
    string
    option env="COMMON_PATH"

menu "seL4 Applications"
    source "apps/minimal-helloworld/Kconfig"
endmenu

menu "seL4 Kernel"
    source "kernel/Kconfig"
endmenu

# This requires HAVE_LIBC which I don't have so don't 
#menu "seL4 Libraries"
#    source "kernel/libsel4/Kconfig"
#endmenu

source "$COMMON_PATH/Kconfig"
```

## apps/minimal-helloworld/Kconfig
```kconfig
#
# Copyright 2015, Wink Saville
#
# This software may be distributed and modified according to the terms of
# the BSD 2-Clause license. Note that NO WARRANTY is provided.
# See "LICENSE_BSD2.txt" for details.

menuconfig APP_MINIMAL_HELLOWORLD
    bool "minimal-helloworld"
    default y
    # Don't depend on LIB_SEL4 yet as it needs HAVE_LIBC which we don't have
    # and don't need it yet anyway.
    #depends on LIB_SEL4
    help
        Minimal Hello World application
```

## libs/libsel4minimal/Kconfig
```kconfig
#
# Copyright 2015, Wink Saville
#
# This software may be distributed and modified according to the terms of
# the BSD 2-Clause license. Note that NO WARRANTY is provided.
# See "LICENSE_BSD2.txt" for details.

menuconfig LIB_SEL4_MINIMAL
    bool "Build the library libsel4minimal"
    default y
    #depends on KERNEL
    help
        This is a minimal sel4 library which doesn't depend on libc
```
